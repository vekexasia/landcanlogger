VERSION ""

NS_ :

BS_:
BU_: mower accessory
BO_ 1552 hello: 2 accessory
   SG_ helloSig417 : 1|1@0+ (1,0) [0|1] "" mower

BO_ 1553 hello_back: 1 mower

BA_DEF_ BO_ "GenMsgBackgroundColor" STRING ;
BA_DEF_ BO_ "GenMsgForegroundColor" STRING ;
BA_ "GenMsgForegroundColor" BO_ 1552 "#ffaa00";
BA_ "GenMsgForegroundColor" BO_ 1553 "#ffaa00";
BA_DEF_DEF_ "GenMsgBackgroundColor" "#ffffff";
BA_DEF_DEF_ "GenMsgForegroundColor" "#000000";
CM_ BU_ mower "The mower";
