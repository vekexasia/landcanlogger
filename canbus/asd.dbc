VERSION ""

NS_ :

BS_:
BU_: mower accessory
BO_ 1552 hello: 2 accessory
   SG_ helloSig417 : 1|1@0+ (1,0) [0|1] "" mower

BO_ 1553 hello_back: 1 mower

BO_ 1048 mowerMsg99: 8 mower
   SG_ error_code? : 63|8@0+ (1,0) [0|1] "" Vector__XXX
   SG_ second_byte : 15|8@0+ (1,0) [0|1] "" Vector__XXX

BA_DEF_ BO_ "GenMsgBackgroundColor" STRING ;
BA_DEF_ BO_ "GenMsgForegroundColor" STRING ;
BA_ "GenMsgForegroundColor" BO_ 1552 "#ffaa00";
BA_ "GenMsgForegroundColor" BO_ 1553 "#ffaa00";
BA_DEF_DEF_ "GenMsgBackgroundColor" "#ffffff";
BA_DEF_DEF_ "GenMsgForegroundColor" "#000000";
CM_ BU_ mower "The mower";
CM_ BO_ 1048 "mower_status?";
CM_ SG_ 1048 second_byte "0x02_or_0x03_not_sure_what_is_the_diff";
